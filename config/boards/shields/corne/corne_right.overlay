/ {
    compatible = "zmk,shield";
};

&spi1 {
    status = "okay";

    led_strip: ws2812 {
        compatible = "worldsemi,ws2812-spi";
        label = "WS2812";
        chain-length = <27>;
        spi-max-frequency = <4000000>;
    };
};
