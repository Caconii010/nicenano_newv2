&spi1 {
    compatible = "nordic,nrf-spi";
    status = "okay";

    mosi-pin = <6>;
    sck-pin = <5>;
    miso-pin = <7>;

    led_strip: ws2812@0 {
        compatible = "worldsemi,ws2812-spi";
        label = "SK6812mini";

        reg = <0>;
        spi-max-frequency = <4000000>;

        chain-length = <27>;

        spi-one-frame = <0x70>;
        spi-zero-frame = <0x40>;
    };
};

/ {
    chosen {
        zmk,underglow = &led_strip;
    };
};
